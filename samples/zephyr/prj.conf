## CMakeLists.txt
```
include($ENV{ZEPHYR_BASE}/cmake/app/boilerplate.cmake NO_POLICY_SCOPE)
project(NONE)

add_library(libsupcpp STATIC IMPORTED)

set_property(TARGET libsupcpp PROPERTY IMPORTED_LOCATION $ENV{GCCARMEMB_TOOLCHAIN_PATH}/arm-none-eabi/lib/thumb/libsupc++.a)

target_link_libraries(app libsupcpp)

set_property(TARGET app PROPERTY LINKER_LANGUAGE C)

target_sources(app PRIVATE build/program.o)

set_source_files_properties(program.o PROPERTIES EXTERNAL_OBJECT true GENERATED true)

add_custom_command(
  OUTPUT program.o
  COMMAND ${CMAKE_COMMAND} -E copy
    ${CMAKE_BINARY_DIR}/kotlin/program.o
    ${CMAKE_BINARY_DIR}/program.o
)
```

## prj.conf
```kconfig
CONFIG_CPLUSPLUS=y
CONFIG_PRINTK=y
CONFIG_BOOT_BANNER=y
CONFIG_BUILD_OUTPUT_BIN=y
```

## src/main.c
```c
/*
 * Copyright 2010-2018 JetBrains s.r.o.
 *
 * Licensed under the Apache License, Version 2.0 (the "License");
 * you may not use this file except in compliance with the License.
 * You may obtain a copy of the License at
 *
 * http://www.apache.org/licenses/LICENSE-2.0
 *
 * Unless required by applicable law or agreed to in writing, software
 * distributed under the License is distributed on an "AS IS" BASIS,
 * WITHOUT WARRANTIES OR CONDITIONS OF ANY KIND, either express or implied.
 * See the License for the specific language governing permissions and
 * limitations under the License.
 */

extern int Konan_main(int argc, const char** argv);
```

## src/main.cpp
```c
/*
 * Copyright (c) 2012-2014 Wind River Systems, Inc.
 *
 * SPDX-License-Identifier: Apache-2.0
 */

#include <zephyr.h>
#include <misc/printk.h>

void main(void)
{
	printk("Hello World! %s\n", CONFIG_ARCH);
}
```

## src/blinky.c
```c
/*
 * Copyright (c) 2016 Intel Corporation
 *
 * SPDX-License-Identifier: Apache-2.0
 */

#include <zephyr.h>
#include <board.h>
#include <device.h>
#include <gpio.h>

/* Change this if you have an LED connected to a custom port */
#define PORT    LED0_GPIO_PORT

/* Change this if you have an LED connected to a custom pin */
#define LED     LED0_GPIO_PIN

/* 1000 msec = 1 sec */
#define SLEEP_TIME 	1000

void blinky(int value)
{
	int cnt = 0;
	struct device *dev;

	dev = device_get_binding(PORT);
	/* Set LED pin as output */
	gpio_pin_configure(dev, LED, GPIO_DIR_OUT);

	while (1) {
		/* Set pin to HIGH/LOW every 1 second */
		gpio_pin_write(dev, LED, cnt % 2);
		cnt++;
		k_sleep(SLEEP_TIME * value);
	}
}
```

## src/empty.c
```c
// This is a placeholder empty C file.
// It is needed for Zephyr to detect the project as C project.
```
