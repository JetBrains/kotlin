## zephyr_proj/board/slate/Kconfig.board
```kconfig
# Copyright (c) 2021 Linaro Limited
# SPDX-License-Identifier: Apache-2.0

config BOARD_SLATE
	bool "Arm Cortex-M55 (Corstone-300, SSE-300 w/Ethos-U55) on SLATE"
	depends on SOC_MPS3_AN547
	select QEMU_TARGET
```

## zephyr_proj/board/slate/Kconfig.defconfig
```kconfig
# Copyright (c) 2018-2021 Linaro Limited
# SPDX-License-Identifier: Apache-2.0

if BOARD_SLATE

config BOARD
	default "slate"

# MPU-based null-pointer dereferencing detection cannot
# be applied as the (0x0 - 0x400) is unmapped but QEMU
# will still permit bus access.
choice NULL_POINTER_EXCEPTION_DETECTION
	bool
	default NULL_POINTER_EXCEPTION_DETECTION_NONE if QEMU_TARGET
endchoice

if GPIO

config GPIO_CMSDK_AHB
	default y

endif # GPIO

if SERIAL

config UART_CMSDK_APB
	default y

config UART_INTERRUPT_DRIVEN
	default y

endif # SERIAL

config I2C_SBCON
	default y
	depends on I2C

endif

config USE_NEMA
	bool "Should use Slate pass on SLATE"
	default n

config DEBUG_MASK
	bool "Should print mask info during draw"
	default n

config DEBUG_DEST
	bool "Should print dest buffer during draw"
	default n

config IS_SLATE_EMULATOR
	bool "indicate if this is slate emulator"
	default n

config DISP_SIZE
	int "the display resolution"
```

## zephyr_proj/board/slate/slate_defconfig
```kconfig
#
# Copyright (c) 2018-2021 Linaro Limited
#
# SPDX-License-Identifier: Apache-2.0
#

CONFIG_SOC_SERIES_MPS3=y
CONFIG_SOC_MPS3_AN547=y
CONFIG_BOARD_SLATE=y
CONFIG_CORTEX_M_SYSTICK=y
CONFIG_RUNTIME_NMI=y
CONFIG_ARM_TRUSTZONE_M=y
CONFIG_ARM_MPU=y
CONFIG_QEMU_ICOUNT_SHIFT=7

# GPIOs
CONFIG_GPIO=y

# Serial
CONFIG_CONSOLE=y
CONFIG_UART_CONSOLE=y
CONFIG_SERIAL=y
CONFIG_UART_CMSDK_APB=y

# Build a Secure firmware image
CONFIG_TRUSTED_EXECUTION_SECURE=y

CONFIG_I2C=y

CONFIG_IS_SLATE_EMULATOR=y
```
